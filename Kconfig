## Kconfig
```kconfig
# Copyright (c) 2021 Teslabs Engineering S.L.
# SPDX-License-Identifier: Apache-2.0

rsource "drivers/Kconfig"
rsource "lib/Kconfig"
```

## boards/arm/nucleof302r8_ihm07m1/Kconfig.board
```kconfig
# Copyright (c) 2021 Teslabs Engineering S.L.
# SPDX-License-Identifier: Apache-2.0

config BOARD_NUCLEOF302R8_IHM07M1
	bool "NUCLEOF302R8 + IHM07M1"
	depends on SOC_STM32F302X8
```

## boards/arm/nucleof302r8_ihm07m1/Kconfig.defconfig
```kconfig
# Copyright (c) 2021 Teslabs Engineering S.L.
# SPDX-License-Identifier: Apache-2.0

if BOARD_NUCLEOF302R8_IHM07M1

config BOARD
	default "nucleof302r8_ihm07m1"

config FPU
	default y

endif # BOARD_NUCLEOF302R8_IHM07M1
```

## boards/arm/nucleof302r8_ihm07m1/nucleof302r8_ihm07m1_defconfig
```kconfig
# Copyright (c) 2021 Teslabs Engineering S.L.
# SPDX-License-Identifier: Apache-2.0

CONFIG_SOC_SERIES_STM32F3X=y
CONFIG_SOC_STM32F302X8=y

CONFIG_PINCTRL=y
CONFIG_GPIO=y
CONFIG_CLOCK_CONTROL=y
```

## boards/arm/nucleog431rb_ihm07m1/Kconfig.board
```kconfig
# Copyright (c) 2021 Teslabs Engineering S.L.
# SPDX-License-Identifier: Apache-2.0

config BOARD_NUCLEOG431RB_IHM07M1
	bool "NUCLEOG431RB + IHM07M1"
	depends on SOC_STM32G431XX
```

## boards/arm/nucleog431rb_ihm07m1/Kconfig.defconfig
```kconfig
# Copyright (c) 2021 Teslabs Engineering S.L.
# SPDX-License-Identifier: Apache-2.0

if BOARD_NUCLEOG431RB_IHM07M1

config BOARD
	default "nucleog431rb_ihm07m1"

config FPU
	default y

endif # BOARD_NUCLEOG431RB_IHM07M1
```

## boards/arm/nucleog431rb_ihm07m1/nucleog431rb_ihm07m1_defconfig
```kconfig
# Copyright (c) 2021 Teslabs Engineering S.L.
# SPDX-License-Identifier: Apache-2.0

CONFIG_SOC_SERIES_STM32G4X=y
CONFIG_SOC_STM32G431XX=y

CONFIG_PINMUX=y
CONFIG_GPIO=y
CONFIG_CLOCK_CONTROL=y
```

## boards/arm/nucleog431rb_ihm16m1/Kconfig.board
```kconfig
# Copyright (c) 2021 Teslabs Engineering S.L.
# SPDX-License-Identifier: Apache-2.0

config BOARD_NUCLEOG431RB_IHM16M1
	bool "NUCLEOG431RB + IHM16M1"
	depends on SOC_STM32G431XX
```

## boards/arm/nucleog431rb_ihm16m1/Kconfig.defconfig
```kconfig
# Copyright (c) 2021 Teslabs Engineering S.L.
# SPDX-License-Identifier: Apache-2.0

if BOARD_NUCLEOG431RB_IHM16M1

config BOARD
	default "nucleog431rb_ihm16m1"

config FPU
	default y

endif # BOARD_NUCLEOG431RB_IHM16M1
```

## boards/arm/p_nucleo_ihm002/Kconfig.board
```kconfig
# Copyright (c) 2021 Teslabs Engineering S.L.
# SPDX-License-Identifier: Apache-2.0

config BOARD_P_NUCLEO_IHM002
	bool "P-NUCLEO-IHM002"
	depends on SOC_STM32F302X8
```

## boards/arm/p_nucleo_ihm002/Kconfig.defconfig
```kconfig
# Copyright (c) 2021 Teslabs Engineering S.L.
# SPDX-License-Identifier: Apache-2.0

if BOARD_P_NUCLEO_IHM002

config BOARD
	default "p_nucleo_ihm002"

config FPU
	default y

endif # BOARD_P_NUCLEO_IHM002
```

## drivers/Kconfig
```kconfig
# Copyright (c) 2021 Teslabs Engineering S.L.
# SPDX-License-Identifier: Apache-2.0

menu "Drivers"

rsource "currsmp/Kconfig"
rsource "feedback/Kconfig"
rsource "svpwm/Kconfig"

endmenu
```

## drivers/currsmp/Kconfig
```kconfig
# Copyright (c) 2021 Teslabs Engineering S.L.
# SPDX-License-Identifier: Apache-2.0

menuconfig SPINNER_CURRSMP
	bool "Current Sample Drivers"
	help
	  Enable options for current sample drivers.

if SPINNER_CURRSMP

module = SPINNER_CURRSMP
module-str = SPINNER_CURRSMP
source "subsys/logging/Kconfig.template.log_config"

config SPINNER_CURRSMP_INIT_PRIORITY
	int "Current sampling init priority"
	default 80
	help
	  Current sampling initialization priority.

rsource "Kconfig.stm32"

endif # SPINNER_CURRSMP
```

## drivers/currsmp/Kconfig.stm32
```kconfig
# Copyright (c) 2021 Teslabs Engineering S.L.
# SPDX-License-Identifier: Apache-2.0

config SPINNER_CURRSMP_SHUNT_STM32
	bool "STM32 shunt current sampling driver"
	depends on SOC_FAMILY_STM32
	default y
	depends on DT_HAS_ST_STM32_CURRSMP_SHUNT_ENABLED
	select SPINNER_UTILS_STM32
	select USE_STM32_LL_ADC
	select ZERO_LATENCY_IRQS
	help
	  Enable shunt current sampling driver for STM32 SoCs
```

## drivers/feedback/Kconfig
```kconfig
# Copyright (c) 2021 Teslabs Engineering S.L.
# SPDX-License-Identifier: Apache-2.0

menuconfig SPINNER_FEEDBACK
	bool "Feedback Drivers"
	help
	  Enable options for feedback drivers.

if SPINNER_FEEDBACK

module = SPINNER_FEEDBACK
module-str = SPINNER_FEEDBACK
source "subsys/logging/Kconfig.template.log_config"

rsource "Kconfig.stm32"

endif # SPINNER_FEEDBACK
```

## drivers/feedback/Kconfig.stm32
```kconfig
# Copyright (c) 2021 Teslabs Engineering S.L.
# SPDX-License-Identifier: Apache-2.0

config SPINNER_FEEDBACK_HALLS_STM32
	bool "STM32 halls feedback driver"
	depends on SOC_FAMILY_STM32
	default y
	depends on DT_HAS_ST_STM32_HALLS_ENABLED
	select USE_STM32_LL_TIM
	help
	  Enable halls driver for STM32 SoCs
```

## drivers/svpwm/Kconfig
```kconfig
# Copyright (c) 2021 Teslabs Engineering S.L.
# SPDX-License-Identifier: Apache-2.0

menuconfig SPINNER_SVPWM
	bool "SV-PWM Drivers"
	help
	  Enable options for SV-PWM drivers.

if SPINNER_SVPWM

module = SPINNER_SVPWM
module-str = SPINNER_SVPWM
source "subsys/logging/Kconfig.template.log_config"

config SPINNER_SVPWM_INIT_PRIORITY
	int "SV-PWM init priority"
	default 90
	help
	  SV-PWM initialization priority.

rsource "Kconfig.stm32"

endif # SPINNER_SVPWM
```

## drivers/svpwm/Kconfig.stm32
```kconfig
# Copyright (c) 2021 Teslabs Engineering S.L.
# SPDX-License-Identifier: Apache-2.0

config SPINNER_SVPWM_STM32
	bool "STM32 SV-PWM driver"
	depends on SOC_FAMILY_STM32
	default y
	depends on DT_HAS_ST_STM32_SVPWM_ENABLED
	select USE_STM32_LL_TIM
	select SPINNER_SVM
	select SPINNER_UTILS_STM32
	help
	  Enable SV-PWM driver for STM32 SoCs

config SPINNER_SVPWM_STM32_PWM_FREQ
	int "PWM frequency"
	default 30000
	depends on SPINNER_SVPWM_STM32
	help
	  PWM frequency (Hz)
```

## dts/bindings/currsmp/st,stm32-currsmp-shunt.yaml
```yaml
# Copyright (c) 2021, Teslabs Engineering S.L.
# SPDX-License-Identifier: Apache-2.0

description: |
  STM32 shunt current sampling driver.

  The shunt current sampling device is expected to be a children of any STM32
  ADC supporting injected conversions. Example usage:

    &adc1 {
      currsmp: currsmp {
        compatible = "st,stm32-currsmp-shunt";
        pinctrl-0 = <&adc1_in1_pa0 &adc1_in7_pc1 &adc1_in6_pc0>;
        pinctrl-names = "default";

        adc-resolution = <12>;
        adc-tsample-us = <2>;
        adc-channels = <1 7 6>;
        adc-trigger = <STM32_ADC_INJ_TRIG_TIM1_TRGO>;
      };
    };

compatible: "st,stm32-currsmp-shunt"

include: [base.yaml, pinctrl-device.yaml]

properties:
  pinctrl-0:
    required: true

  pinctrl-names:
    required: true

  adc-resolution:
    type: int
    required: true
    description: |
      ADC resolution in bits. Available resolutions can differ depending on
      the selected SoC family.

  adc-tsample:
    type: int
    required: true
    description: |
      ADC sampling time in cycles. Decimal sampling times must be rounded
      up, e.g. 19.5 needs to be provided as 20. Available sample times can
      differ depending on the SoC family.

  adc-channels:
    type: array
    required: true
    description: |
      ADC channels (a, b, c).

  adc-trigger:
    type: int
    required: true
    description: |
      External trigger for the injected ADC conversions. The external trigger
      must be an output of the timer used for SV-PWM.

      Definitions available at dts-bindings/adc/stm32fxxx.h files.
```

## dts/bindings/feedback/st,stm32-halls.yaml
```yaml
# Copyright (c) 2021, Teslabs Engineering S.L.
# SPDX-License-Identifier: Apache-2.0

description: |
  Halls sensor driver for STM32 microcontrollers.

  The halls device is expected to be a children of any STM32 timer supporting
  the HALLS interface. Example usage:

      &timers2 {
        status = "okay";

        feedback: feedback {
            compatible = "st,stm32-halls";

            pinctrl-0 = <&tim2_ch1_pa15 &tim2_ch2_pb3 &tim2_ch3_pb10>;
            pinctrl-names = "default";

            h1-gpios = <&gpioa 15 0>;
            h2-gpios = <&gpiob 3 0>;
            h3-gpios = <&gpiob 10 0>;
            phase-shift = <60>;
        };
      };

compatible: "st,stm32-halls"

include: [base.yaml, pinctrl-device.yaml]

properties:
  pinctrl-0:
    required: true

  pinctrl-names:
    required: true

  h1-gpios:
    type: phandle-array
    required: true
    description: |
      H1 GPIO

  h2-gpios:
    type: phandle-array
    required: true
    description: |
      H2 GPIO

  h3-gpios:
    type: phandle-array
    required: true
    description: |
      H3 GPIO

  phase-shift:
    type: int
    default: 0
    description: |
      Phase shift between the low to high transition of signal H1 and the
      maximum of the Bemf induced on phase A.
```

## dts/bindings/motor/motor-driver.yaml
```yaml
# Copyright (c) 2022, Teslabs Engineering S.L.
# SPDX-License-Identifier: Apache-2.0

description: Bindings for motor driver ICs/circuits

include: base.yaml

properties:
  enable-comp-outputs:
    type: boolean
    description: |
      Enable complementary outputs, used to control the low side channels of
      each inverter leg.

  t-dead-ns:
    type: int
    required: false
    description: |
      Dead time in nanoseconds. If using an integrated controller, i.e. without
      complementary PWM signals, it still needs to be provided to configure
      accurate current measurements.

  t-rise-ns:
    type: int
    required: false
    description: |
      Rise time in nanoseconds.

  enable-gpios:
    type: phandle-array
    description: |
      Channel enable GPIOS (a, b, c).
```

## dts/bindings/motor/st,l6230.yaml
```yaml
# Copyright (c) 2022, Teslabs Engineering S.L.
# SPDX-License-Identifier: Apache-2.0

description: STM32 L6230 DMOS driver for three-phase brushless DC motor

compatible: "st,l6230"

include: motor-driver.yaml

properties:
  t-dead-ns:
    # L6230 dead time (Table 6)
    default: 1000

  t-rise-ns:
    # L6230 rise time: tD(ON) + tRISE (Fig. 4)
    default: 1050

  enable-gpios:
    required: true
```

## dts/bindings/motor/st,stspin830.yaml
```yaml
# Copyright (c) 2022, Teslabs Engineering S.L.
# SPDX-License-Identifier: Apache-2.0

description: |
  STM32 STSPIN830 Compact and versatile three-phase and three-sense motor
  driver.

compatible: "st,stspin830"

include: motor-driver.yaml

properties:
  t-rise-ns:
    # STSPIN830 rise time: tINd(ON) + tRISE (Table 5)
    default: 670

  enable-gpios:
    required: true
```
