/*
 * Copyright (c) 2021 Teslabs Engineering S.L.
 *
 * SPDX-License-Identifier: Apache-2.0
 */

&svpwm {
	pinctrl-0 = <&tim1_ch1_pa8 &tim1_ch2_pa9 &tim1_ch3_pa10 &tim1_bkin2_pa11>;
	pinctrl-names = "default";
};

&currsmp {
	pinctrl-0 = <&adc1_in1_pa0 &adc1_in7_pc1 &adc1_in6_pc0>;
	pinctrl-names = "default";

	adc-channels = <1 7 6>;
};

&feedback {
	pinctrl-0 = <&tim2_ch1_pa15 &tim2_ch2_pb3 &tim2_ch3_pb10>;
	pinctrl-names = "default";
};
