## dts/bindings/svpwm/st,stm32-svpwm.yaml
```yaml
# Copyright (c) 2021, Teslabs Engineering S.L.
# SPDX-License-Identifier: Apache-2.0

description: |
  STM32 SV-PWM device.

  The SV-PWM device is expected to be a children of any STM32 advanced control
  timer. Example usage:

      &timers1 {
          svpwm: svpwm {
              compatible = "st,stm32-svpwm";
              pinctrl-0 = <&tim1_ch1_pa8 &tim1_ch2_pa9 &tim1_ch3_pa10 &tim1_ocp_pa11>;
              pinctrl-names = "default";
              ...
          };
      };

compatible: "st,stm32-svpwm"

include: [base.yaml, pinctrl-device.yaml]

properties:
  pinctrl-0:
    required: true

  pinctrl-names:
    required: true

  currsmp:
    type: phandle
    required: true
    description: |
      Current sampling device.
```

## lib/Kconfig
```kconfig
# Copyright (c) 2021 Teslabs Engineering S.L.
# SPDX-License-Identifier: Apache-2.0

menu "Libraries"

rsource "control/Kconfig"
rsource "svm/Kconfig"
rsource "utils/Kconfig"

endmenu
```

## lib/control/Kconfig
```kconfig
# Copyright (c) 2021 Teslabs Engineering S.L.
# SPDX-License-Identifier: Apache-2.0

menuconfig SPINNER_CLOOP
	bool "Current Loop"
	select SPINNER_SVM
	select CMSIS_DSP
	select CMSIS_DSP_CONTROLLER
	select CMSIS_DSP_TABLES_ARM_SIN_COS_F32
	depends on SPINNER_CURRSMP && SPINNER_FEEDBACK && SPINNER_SVPWM

if SPINNER_CLOOP

config SPINNER_CLOOP_SHELL
	bool "Control loop shell"
	default y
	depends on SHELL
	help
	  Utility shell to test current loop.

config SPINNER_CLOOP_T_KP
	int "Torque PID proportional constant"
	default 1500
	help
	  Torque PID controller proportional (Kp) constant. Value is in thousands.

config SPINNER_CLOOP_T_KI
	int "Torque PID integral constant"
	default 0
	help
	  Torque PID controller Integral (Ki) constant. Value is in thousands.

config SPINNER_CLOOP_F_KP
	int "Flux PID proportional constant"
	default 1500
	help
	  Flux PID controller proportional (Kp) constant. Value is in thousands.

config SPINNER_CLOOP_F_KI
	int "Flux PID integral constant"
	default 0
	help
	  Flux PID controller integral (Ki) constant. Value is in thousands.

endif # SPINNER_CLOOP
```

## lib/svm/Kconfig
```kconfig
# Copyright (c) 2021 Teslabs Engineering S.L.
# SPDX-License-Identifier: Apache-2.0

config SPINNER_SVM
	bool "Space Vector Modulator"
	select CMSIS_DSP
	select CMSIS_DSP_FASTMATH
	help
	  Space Vector Modulator.
```

## lib/utils/Kconfig
```kconfig
config SPINNER_UTILS_STM32
	bool "STM32 utilities"
	select USE_STM32_LL_RCC
	help
	  Enable common utilities for STM32 SoCs.
```

## spinner/Kconfig
```kconfig
# Copyright (c) 2021 Teslabs Engineering S.L.
# SPDX-License-Identifier: Apache-2.0

source "Kconfig.zephyr"
```

## spinner/sample.yaml
```yaml
# Copyright (c) 2024 Teslabs Engineering S.L.
# SPDX-License-Identifier: Apache-2.0

sample:
  description: Spinner
  name: spinner

common:
  build_only: true

tests:
  spinner.ihm07m1:
    integration_platforms:
      - nucleo_f302r8
      - nucleo_g431rb
    extra_args:
      SHIELD=ihm07m1

  spinner.ihm16m1:
    integration_platforms:
      - nucleo_f302r8
      - nucleo_g431rb
    extra_args:
      SHIELD=ihm16m1
```

## tests/lib/svm/testcase.yaml
```yaml
# Copyright (c) 2021 Teslabs Engineering S.L.
# SPDX-License-Identifier: Apache-2.0

tests:
  lib.svm:
    tags: lib svm
    integration_platforms:
      - native_posix
```

## west.yml
```yaml
# Copyright (c) 2021 Teslabs Engineering S.L.
# SPDX-License-Identifier: Apache-2.0

manifest:
  self:
    path: spinner

  remotes:
    - name: zephyr
      url-base: https://github.com/zephyrproject-rtos

  projects:
    - name: zephyr
      remote: zephyr
      repo-path: zephyr
      revision: main
      import:
        name-allowlist:
          - cmsis
          - hal_stm32
```
